/* Net N_3carros_TD - IOPT */
/* Automatic code generated by IOPT2C XSLT transformation. */
/* Changed by IOPT2AC to run in Arduino */
/* Please fill the necessary code to perform hardware IO. */

#include <stdlib.h>
#include "net_types.h"

#include <Arduino.h>
#define ANALOG_IN_MAX  1023
#define ANALOG_OUT_MAX 255

//PYTHON - Initializations
#include <Wire.h>
#define I2C_ADDRESS_ME 0x3
#define I2C_ADDRESS_event71 0x3
#define I2C_ADDRESS_event73 0x3
#define I2C_ADDRESS_event114 0x2
#define I2C_ADDRESS_event115 0x2
#define I2C_ADDRESS_event116 0x1
#define I2C_ADDRESS_event117 0x1
#define I2C_ADDRESS_event70 0x1
#define I2C_ADDRESS_event72 0x1
String readString;
int event71_flag = 0;
int event73_flag = 0;
//PYTHON - End Initializations

//PYTHON - Receive Listener Function
void receiveI2C(int num) {
    readString = "";
    while (Wire.available() > 0) {
        delay(4);
        char c = Wire.read();
        readString += c;
    }
    if(readString == "event71") {
        event71_flag = 1;
    }    if(readString == "event73") {
        event73_flag = 1;
    }
}
//PYTHON - End Listener Function

/* Executed just once, before net execution starts: */
void N_3carros_TD_InitializeIO()
{
    //PYTHON - Initialize digital outputs
    pinMode(2, OUTPUT);
    digitalWrite(2, LOW);
    pinMode(3, OUTPUT);
    digitalWrite(3, LOW);
    pinMode(4, OUTPUT);
    digitalWrite(4, LOW);
    pinMode(5, OUTPUT);
    digitalWrite(5, LOW);
    pinMode(6, OUTPUT);
    digitalWrite(6, LOW);
    pinMode(7, OUTPUT);
    digitalWrite(7, LOW);
    pinMode(8, OUTPUT);
    digitalWrite(8, LOW);
    pinMode(9, OUTPUT);
    digitalWrite(9, LOW);
    pinMode(10, OUTPUT);
    digitalWrite(10, LOW);
    pinMode(11, OUTPUT);
    digitalWrite(11, LOW);
    pinMode(12, OUTPUT);
    digitalWrite(12, LOW);
    pinMode(13, OUTPUT);
    digitalWrite(13, LOW);
    //PYTHON - Initialize serial and i2c communications
    Serial.begin(9600);
    Wire.begin(I2C_ADDRESS_ME);
    //PYTHON - End serial and i2c initializations
}

/* Read all hardware input signals and fill data-structure */
void N_3carros_TD_GetInputSignals(
    N_3carros_TD_InputSignals* inputs,
    N_3carros_TD_InputSignalEvents* events )
{
    /* No Inputs*/

    if( events != NULL ) {
        // PYTHON - Change event state
        if (event71_flag) {
            events->event71 = 1;
            event71_flag = 0;
        } else {
            events->event71 = 0;
        }
        if (event73_flag) {
            events->event73 = 1;
            event73_flag = 0;
        } else {
            events->event73 = 0;
        }
        //PYTHON - End change event state
    }
}

/* Write all output values to physical hardware outputs */
void N_3carros_TD_PutOutputSignals(
    N_3carros_TD_PlaceOutputSignals* place_out,
    N_3carros_TD_EventOutputSignals* event_out,
    N_3carros_TD_OutputSignalEvents* events )
{
    //PYTHON - Digital write the outputs
    digitalWrite(2, place_out->Car6_ready);
    digitalWrite(3, place_out->Car6_arrived);
    //PYTHON - End digital write the outputs

    if( events != NULL ) {
        //PYTHON - Send communication
        if (events->event70) {
            Wire.beginTransmission(I2C_ADDRESS_event70);
            Wire.write("event70");
            Wire.endTransmission();
        }
        if (events->event72) {
            Wire.beginTransmission(I2C_ADDRESS_event72);
            Wire.write("event72");
            Wire.endTransmission();
        }
        //PYTHON - End send communication
    }

}

/* Delay between loop iterations to save CPU and power consumption */
void N_3carros_TD_LoopDelay()
{
    //PYTHON - Loop config
    delay(10);
    Serial.println("Loop 0x3");
    Wire.onReceive(receiveI2C);
    //PYTHON - End loop config
}

/* Must return 1 to finish net execution */
int N_3carros_TD_FinishExecution( N_3carros_TD_NetMarking* marking )
{
    return 0;
}